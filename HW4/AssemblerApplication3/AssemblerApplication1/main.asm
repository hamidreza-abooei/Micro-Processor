;
; AssemblerApplication1.asm
;
; Created: 4/24/2022 1:58:53 PM
; Author : Hamidreza
.ORG 0
	RJMP START
.ORG 0x02
	RJMP EX0_INT_ISR
.ORG 0X04
	RJMP EX1_INT_ISR


START:
	LDI R16,LOW(RAMEND)
	OUT SPL,R16
	LDI R16,HIGH(RAMEND)
	OUT SPH,R16
	SBI PORTD,2
	LDI R20,1<<INT0	| 1<<INT1
	OUT GICR,R20	;ENABLE INT0
	SBI PORTD,2		;PULL-UP	D2
	SBI PORTD,3		;PULL-UP	D3
	SER R16
	OUT DDRA,R16	;OUTPUT
	OUT DDRB,R16	;OUTPUT
	CLR R16
	OUT DDRC,R16	;INPUT
	SER R16
	OUT PORTC,R16	;PULLUP

	LDI R16,1<<ISC01 | 1<<ISC01 ;FALLING EDGE
	OUT MCUCR,R16
	SEI

HERE:
	RJMP HERE

EX0_INT_ISR:
	IN R16,PINC
	NEG R16
	OUT PORTA,R16
	RETI				


EX1_INT_ISR:
	IN R16,PINC
	COM R16
	OUT PORTB,R16
	RETI